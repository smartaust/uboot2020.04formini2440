## arch/arm/mach-s3c24x0/Kconfig
```kconfig
if ARCH_S3C24X0

config SYS_SOC
	default "S3C24x0"

config SYS_VENDOR
	default "SAMSUNG"

config S3C24X0
	bool "SAMSUNG S3C24X0 SoC"
	default y
choice
	prompt "S3C24X0 board select"

config TARGET_MINI2440
	bool "Friendly ARM mini2440 Board"
	help
	  The SAMSUNG is a ARM-based SoC with a arm920T core.
	  including UART, SPI, USB1.0, SD and MMC cards, NAND , PWM,
	  Gigabit Ethernet, I2C.

config TARGET_TBD
	bool "SAMSUNG S3C24XX SoC"
	help
	  TBD: use to extern new board
endchoice

source "board/samsung/mini2440/Kconfig"

endif
```

## arch/arm/mach-s3c24xx/Kconfig
```kconfig
if ARCH_S3C24XX

config SYS_SOC
	default "S3C2440"

config SYS_VENDOR
	default "SAMSUNG"

config S3C2440
	bool "SAMSUNG S3C2440 SoC"
	default n

choice
	prompt "S3C24XX board select"

config TARGET_MINI2440
	bool "Friendly ARM mini2440 Board"
	help
	  The SAMSUNG is a ARM-based SoC with a arm920T core.
	  including UART, SPI, USB1.0, SD and MMC cards, NAND , PWM,
	  Gigabit Ethernet, I2C.

config TARGET_TBD
	bool "SAMSUNG S3C24XX SoC"
	help
	  TBD: use to extern new board
endchoice

source "board/samsung/mini2440/Kconfig"

endif
```

## board/samsung/mini2440/Kconfig
```kconfig
if TARGET_MINI2440

config SYS_BOARD
	default "mini2440"

config SYS_VENDOR
	default "Friendly ARM"

config SYS_CONFIG_NAME
	default "mini2440"

config S3C2440
	bool "SAMSUNG S3C2440 SoC"
	default y
endif
```
